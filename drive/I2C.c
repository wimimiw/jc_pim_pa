/**-------------文件信息--------------------------------------------------------------------------------
**文   件   名: I2C.c
**创   建   人: 程莺红
**修   改   人: 
**最后修改日期: 2006年3月31日
**最 新 版  本: V1.2
**描        述: I2C总线的驱动，读写I2C总线
				相应寄存器 
				地址寄存器 		I2ADR  用于存放自身从地址（从方式时才有用）
    			数据寄存器 		I2DAT  接收/发送数据用
				控制寄存器 		I2CON  用于I2C的设置、使能、启动、结束
			          	   			    应答控制、中断标志等
				状态寄存器 		I2STAT 指示I2C总线的操作状态码
				SCL占空比寄存器 I2SCLH 设置SCL的频率发生
								I2CSCLL
**
**--------------历史版本信息----------------------------------------------------------------------------
** 创建人: 程莺红 
** 版  本: V1.2
** 日　期: 2006年3月31日
** 描　述: 原始版本
**
********************************************************************************************************/
#include <reg938.h>
#include <I2C.h>



/*******************************************************************
*                  申请总线
* 功能：进行I2C总线的初始化－－包括时钟选择，I2C使能，发送起始信号等等。
*       I2EN为1，设置为主机；CRSEL位为0，使用内部SCL发生器。
*******************************************************************/
void GetBus()
{
	I2SCLH = 15;	//设置SCL高电平的PCLK周期数
	I2SCLL = 15;	//设置SCL低电平的PCLK周期数，
	/*申请成为主机，发动总线，使用内部SCL发生器，I2EN和AA置位*/
	I2CON = Release_bus_sta;
	while(SI == 0);
}


/*******************************************************************
*                    发送数据函数
* 功能：用于向总线发送数据 
* 入口参数：ACC   待发送的数据                   
*******************************************************************/
void SendByte(unsigned char c)
{ I2DAT = c;
  I2CON = Release_bus_ack;    	/* 清除SI位等等   		*/
  while( SI==0 );        		/* 等待数据的发送 		*/
}	   
/*******************************************************************
*                    向器件发送多字节数据函数                 
* 功能：从启动总线到发送地址，子地址,数据，结束总线的全过程。
* 入口参数；sla		从器件地址
*           s       发送内容的指针
*           no      发送字节数
* 出口参数：返回1表示操作成功，否则操作有误。
********************************************************************/
unsigned char ISendStrExt(unsigned char sla,unsigned char *s, unsigned char no)
{ unsigned char xdata i;

  GetBus();                 /* 启动总线               	*/
  SendByte(sla);            /* 发送器件地址           	*/
  if( I2STAT!=0X18 )
  { 
    I2CON = Generate_stop;
    return(0);
  }
    
  for(i=0; i<no; i++)
  { 
    SendByte(*s);           /* 发送数据					*/
    if( I2STAT!=0X28 )
	{ I2CON = Generate_stop;
	  return(0);
	}
    s++;
  } 

  I2CON = Generate_stop;    /* 结束总线					*/ 
  return(1);
}
/*******************************************************************
*                    向有子地址器件读取多字节数据函数                
*功能：从启动总线到发送地址，子地址,读数据，结束总线的全过程。
*入口参数：sla 		从器件地址
*          suba		子地址(就是IIC器件里面的某个寄存器地址)
*		   s	    读出的内容存储区的指针
*          no		读no个字节。
*出口参数：函数返回1表示操作成功，否则操作有误。
********************************************************************/
unsigned char IRcvStr(unsigned char sla,unsigned char suba,unsigned char *s,unsigned char no)
{ unsigned char i;

  GetBus();                	/* 启动总线						*/
  SendByte(sla);            /* 发送器件地址					*/
  if( I2STAT!=0X18)
  { I2CON = Generate_stop;
    return(0);
  }
  SendByte(suba);           /* 发送器件子地址				*/
  if( I2STAT!=0X28 )
  { I2CON = Generate_stop;
    return(0);
  }

  I2CON = Release_bus_sta;  /* 重新启动总线					*/
  while( SI==0 );
  SendByte(sla+1);
  if( I2STAT!=0X40 )
  { I2CON = Generate_stop;
    return(0);
  } 
   
  for(i=0; i<no-1; i++)
  { I2CON = Release_bus_ack;   /* 接收一字节数据并发送应答位		*/
    while( SI==0 );            /* 等待接收数据						*/  
    if( I2STAT!=0X50 )
	{ I2CON = Generate_stop;
	  return(0);
	}
    *s = I2DAT;                /* 读取数据							*/ 
    s++;
  } 
  I2CON = Release_bus_noack;   /* 接收最后一字节数据并发送非应答位	*/
  while( SI==0 );  
  *s = I2DAT;
  I2CON = Generate_stop;       /* 结束总线							*/ 
  return(1);
}